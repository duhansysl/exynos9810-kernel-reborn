## arch/arm64/configs/ds_defconfig
```kconfig
#
#
# DS Defconfig
#
#
CONFIG_BOEFFLA_WL_BLOCKER=y
CONFIG_CUSTOM_FORCETOUCH=y
CONFIG_SEC_INPUT_BOOSTER=y
CONFIG_ARGOS=y
CONFIG_ARGOS_CLUSTER_NUM=2
CONFIG_PROC_AVC=y
CONFIG_PAGE_BOOST=y
CONFIG_PAGE_BOOST_RECORDING=y
#
# SEC Memory Management Options
#
CONFIG_SEC_MM=y
#
# MoroSound
#
CONFIG_MORO_SOUND=y
```

## drivers/media/platform/exynos/Kconfig
```kconfig
#
# Exynos multimedia device drivers
#
config VIDEO_EXYNOS
        bool "Exynos Multimedia Devices"
        depends on ARCH_EXYNOS
        default y
        help
          This is a representative exynos multimedia device.

config VIDEO_SAMSUNG_R7
	bool "Galaxy R7 camera support"
	depends on SOC_EXYNOS9810
	help
	  Include the fimc-is2 driver for Galaxy R7

if VIDEO_EXYNOS
        source "drivers/media/platform/exynos/scaler/Kconfig"
        source "drivers/media/platform/exynos/g2d1shot/Kconfig"
        source "drivers/media/platform/exynos/mfc/Kconfig"
        source "drivers/media/platform/exynos/smfc/Kconfig"
        if VIDEO_SAMSUNG_R7
                source "drivers/media/platform/exynos/fimc-is2-r7/Kconfig"
        endif
        if !VIDEO_SAMSUNG_R7
                source "drivers/media/platform/exynos/fimc-is2/Kconfig"
        endif
        source "drivers/media/platform/exynos/camera-pp/Kconfig"
        source "drivers/media/platform/exynos/repeater/Kconfig"
        source "drivers/media/platform/exynos/tsmux/Kconfig"
        source "drivers/media/platform/exynos/astc/Kconfig"		
endif

config MEDIA_EXYNOS
        bool
        depends on VIDEO_EXYNOS
        default y
        help
          Compile mdev to use exynos media device driver.
```

## drivers/media/platform/exynos/fimc-is2-r7/vendor/Kconfig
```kconfig
menu "Vendor Feature Setting"
	depends on EXYNOS_FIMC_IS

choice
	prompt "Use vender features"
	depends on EXYNOS_FIMC_IS
	default R7_VENDER_DEFAULT
	help
	  Use the vender specific features.

config R7_VENDER_DEFAULT
        bool "Default"
config R7_VENDER_MCD
        bool "MCD"
endchoice

source "drivers/media/platform/exynos/fimc-is2-r7/vendor/default/Kconfig"
source "drivers/media/platform/exynos/fimc-is2-r7/vendor/mcd/Kconfig"
endmenu
```

## drivers/media/platform/exynos/fimc-is2-r7/vendor/default/Kconfig
```kconfig
#
# Generic vendor feature config states
#

# Enable the vendor features
config SECURE_CAMERA_USE
	bool "Use secure camera"
	depends on R7_VENDER_DEFAULT
	default n
	---help---
	  Use secure camera.
```

## drivers/samsung/debug/Kconfig
```kconfig
# drivers/samsung/debug/Kconfig
#
# Copyright (c) 2010-2011 Samsung Electronics Co., Ltd.
#		http://www.samsung.com/
#
# Licensed under GPLv2

menuconfig SEC_DEBUG
	bool "Enable TN debugging features"
	depends on EXYNOS_SNAPSHOT && SEC_REBOOT
	default y

config SEC_DEBUG_RESET_REASON
	bool "Enable TN reset reason"
	depends on SEC_DEBUG
	default y
	help
	  This option enables storing reset reason history file
	  This option enables reading the reset reason history using proc/reset_reason file

config SEC_DEBUG_EXTRA_INFO
	bool "Enable TN reset reason extra info"
	depends on SEC_DEBUG && SEC_DEBUG_RESET_REASON
	default y
	help
	  This option enables storing reset reason extra info
	  This option enables ap reset info bigdata based on reset reason extra info

config SEC_DEBUG_HW_PARAM
	bool "Enable TN HW PARAM bigdata info"
	depends on SEC_DEBUG && SEC_DEBUG_RESET_REASON
	default y
	help
	  This option enables storing hw param bigdata info

config SEC_DEBUG_UPLOAD
	bool "Enable Upload mode"
	depends on SEC_DEBUG
	default y
	help
	  Samsung TN upload mode

comment "Samsung TN Logging Options"
config SEC_AVC_LOG
	default n
	bool "Enable avc audit log support" if EMBEDDED
	depends on SEC_EXT
	help
	  This option enables additional log buffer for audit log.

config SEC_DEBUG_TSP_LOG
	default n
	bool "Enable tsp log support" if EMBEDDED
	depends on SEC_EXT
	help
	  This option enables additional log buffer for tsp log.

config SEC_DEBUG_AUTO_SUMMARY
	bool "Enable TN kernel fault auto summary"
	depends on SEC_DEBUG
	default y
	help
	  This option enables kernel fault auto summary feature
	  This option also requires bootloader change that enables auto summary extraction along with ramdump

config SEC_DEBUG_LAST_KMSG
	bool "Write last_kmsg at /proc/last_kmsg"
	depends on SEC_DEBUG
	default y
	help
	  This option enables /proc/last_kmsg support. This stores the previous
	  kernel log into separate buffer. /proc/last_kmsg shows the stored log.

config SEC_DEBUG_INIT_LOG
	bool "support hooking of init task log"
	depends on SEC_DEBUG
	default y
	help
	  This option enables hooking of init task log. 
	  It can be used for debugging purpose in case of booting failure or something else.
	
config SEC_DEBUG_PPMPU
	bool "Print ppmpu inforamtion by smc call"
	depends on SEC_DEBUG
	default n
	help
	  This option enables the kernel to print out ppmpu information when
	  kernel oops. El3 monitor supports smc calls for this option.

config SEC_DEBUG_BRANCH_VERIFIER
	bool "Warning a invalid branch from backtrace"
	depends on SEC_DEBUG && SEC_DEBUG_AUTO_SUMMARY
	default n
	help
	  This option enables the kernel to check whether branches from
	  dump_backtrace() are valid. Then it will print a warning if a wrong jump
	  is detected.

config SEC_DEBUG_INDIRECT_BRANCH_VERIFIER
	bool "Warning a invalid branch for blr"
	depends on SEC_DEBUG_BRANCH_VERIFIER
	depends on RKP_CFP_JOPP
	default n
	help
	  This option enables the branch verifier to check branches including
	  indirect branches like blr. It also needs a compiler modified.

config SEC_DEBUG_INIT_EXIT_PANIC
	bool "Trigger panic when exiting init task group"
	depends on SEC_DEBUG
	default y
	help
	  This option enables early panic when it attempt to kill init tasks.
	  It may happen before init task stack is destroyed for debugging.

config SEC_DEBUG_SOFTDOG_PWDT
	bool "Enable Soft Watchdog for Platform"
	default n
	depends on WATCHDOG
	select SOFT_WATCHDOG
	help
	  This option enables soft watchdog device and soft_panic.

comment "Logging Heavy Task Cpu Options"
config SEC_HEAVY_TASK_CPU
	bool "Enable heacy cpu core counting"
	default n
	help
	  This option enables heavy cpu core counting.

comment "Samsung ubsan debug feature"
config SEC_DEBUG_UBSAN
	bool "Enable ubsan debug feature"
	default n
	help
	  This option enables ubsan debug feature.

comment "Samsung kasan debug feature"
config SEC_DEBUG_KASAN
	bool "Enable kasan debug feature"
	default n
	help
	  This option enables kasan debug feature.

config SEC_DEBUG_SUPPORT_FORCE_UPLOAD
	bool "Support force upload mode"
	default n
	help
	  This option supports force upload mode.
```
